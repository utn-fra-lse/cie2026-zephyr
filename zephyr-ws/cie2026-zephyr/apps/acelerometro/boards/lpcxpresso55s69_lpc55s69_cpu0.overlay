/*
 * LPCXpresso55S69: FLEXCOMM4 en modo I2C (header Arduino/mikroBUS).
 * El acelerómetro MMA8652FC integrado ya es accel0 en el devicetree de la
 * placa; este overlay solo nombra el bus para el MPU6050.
 */
sensor_i2c: &flexcomm4 {
	status = "okay";
};
