## CMakeLists.txt
```
# SPDX-License-Identifier: Apache-2.0
cmake_minimum_required(VERSION 3.20.0)
find_package(Zephyr REQUIRED HINTS $ENV{ZEPHYR_BASE})
project(temperatura)

target_sources(app PRIVATE src/main.c)
```

## prj.conf
```kconfig
# ---- APIs que usa la aplicación ----
# El driver concreto del sensor de temperatura interno (RP2040, STM32,
# ESP32, i.MX RT, Kinetis, MCX...) se habilita solo por el devicetree.
# Muchos de esos sensores se leen a través del ADC del propio chip.
CONFIG_SENSOR=y
CONFIG_ADC=y

# ---- Logging, con punto flotante para mostrar las lecturas ----
CONFIG_LOG=y
CONFIG_CBPRINTF_FP_SUPPORT=y
```

## boards/blackpill_f401cc.overlay
```dts
/*
 * Black Pill F401: el sensor interno del STM32 se lee por el canal 16 del
 * ADC1, con la calibración de fábrica guardada en el chip.
 */
&die_temp {
	status = "okay";
};

/ {
	aliases {
		die-temp0 = &die_temp;
	};
};
```

## boards/esp32c3_supermini.overlay
```dts
/*
 * ESP32-C3 SuperMini: sensor de temperatura dedicado del ESP32-C3. El SoC
 * ya define el alias die-temp0.
 */
&coretemp {
	status = "okay";
};
```

## boards/esp32s3_devkitc_esp32s3_procpu.overlay
```dts
/*
 * ESP32-S3 DevKitC: sensor de temperatura dedicado del ESP32-S3. El SoC ya
 * define el alias die-temp0.
 */
&coretemp {
	status = "okay";
};
```

## boards/frdm_k64f.overlay
```dts
/*
 * FRDM-K64F: la placa ya habilita el sensor interno (temp1, leído por el
 * ADC1). Solo falta el alias genérico.
 */
/ {
	aliases {
		die-temp0 = &temp1;
	};
};
```

## boards/frdm_mcxn236.overlay
```dts
/*
 * FRDM-MCXN236: el sensor interno se lee por el LPADC0, en modo diferencial
 * entre los canales 26A y 26B.
 * La placa ya define el alias die-temp0; hay que configurar el canal del
 * ADC y habilitar el sensor.
 */
#include <zephyr/dt-bindings/adc/adc.h>
#include <zephyr/dt-bindings/adc/mcux-lpadc.h>

&lpadc0 {
	status = "okay";
	#address-cells = <1>;
	#size-cells = <0>;

	channel@0 {
		reg = <0>;
		zephyr,gain = "ADC_GAIN_1";
		zephyr,reference = "ADC_REF_EXTERNAL0";
		zephyr,acquisition-time = <ADC_ACQ_TIME(ADC_ACQ_TIME_TICKS, 131)>;
		zephyr,differential;
		zephyr,input-positive = <MCUX_LPADC_CH26A>;
		zephyr,input-negative = <MCUX_LPADC_CH26B>;
	};
};

&temp0 {
	status = "okay";
	io-channels = <&lpadc0 0>;
};
```

## boards/rpi_pico.overlay
```dts
/*
 * Raspberry Pi Pico: el RP2040 trae un sensor de temperatura en el canal 4
 * del ADC. El SoC ya define el alias die-temp0; solo hay que habilitarlo.
 */
&die_temp {
	status = "okay";
};
```

## src/main.c
```c
/*
 * temperatura - Laboratorio de Sistemas Embebidos, UTN FRA
 *
 * Lee el sensor de temperatura interno del microcontrolador cada dos
 * segundos.
 *
 * La aplicación solo conoce el alias "die-temp0", el nombre estándar que
 * usa Zephyr para el sensor de temperatura del chip. Cada SoC lo implementa
 * distinto (un canal del ADC, un periférico dedicado...), pero la
 * aplicación siempre pide lo mismo: SENSOR_CHAN_DIE_TEMP.
 *
 * SPDX-License-Identifier: Apache-2.0
 */

#include <zephyr/kernel.h>
#include <zephyr/device.h>
#include <zephyr/drivers/sensor.h>
#include <zephyr/logging/log.h>

LOG_MODULE_REGISTER(temperatura, LOG_LEVEL_INF);

#if !DT_NODE_EXISTS(DT_ALIAS(die_temp0))
#error "Falta el alias 'die-temp0': esta placa no tiene sensor de temperatura interno soportado"
#endif

static const struct device *const sensor = DEVICE_DT_GET(DT_ALIAS(die_temp0));

int main(void)
{
	struct sensor_value temp;

	LOG_INF("temperatura en %s (SoC %s)", CONFIG_BOARD_TARGET, CONFIG_SOC);

	if (!device_is_ready(sensor)) {
		LOG_ERR("El sensor %s no esta listo", sensor->name);
		return -ENODEV;
	}
	LOG_INF("Sensor: %s", sensor->name);

	while (1) {
		if (sensor_sample_fetch_chan(sensor, SENSOR_CHAN_DIE_TEMP) < 0 ||
		    sensor_channel_get(sensor, SENSOR_CHAN_DIE_TEMP, &temp) < 0) {
			LOG_WRN("Error al leer el sensor");
		} else {
			LOG_INF("Temperatura del chip: %.1f C", sensor_value_to_double(&temp));
		}
		k_msleep(2000);
	}

	return 0;
}
```
